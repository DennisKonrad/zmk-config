/ {
    chosen {
        zmk,scan = &kscan0;
    };
};

&kscan0 {
    label = "Left KScan";
    diode-direction = <KS_CAN_COL2ROW>;  // Strom fließt von Spalte zu Reihe
    row-gpios = < &gpio0 0 GPIO_ACTIVE_HIGH >, // Reihe 0
                < &gpio0 1 GPIO_ACTIVE_HIGH >, // Reihe 1
                < &gpio0 2 GPIO_ACTIVE_HIGH >, // Reihe 2
                < &gpio0 3 GPIO_ACTIVE_HIGH >; // Reihe 3
                < &gpio0 4 GPIO_ACTIVE_HIGH >; // Reihe 4 

    col-gpios = < &gpio0 5 GPIO_ACTIVE_HIGH >, // Spalte 0
                < &gpio0 6 GPIO_ACTIVE_HIGH >, // Spalte 1
                < &gpio0 7 GPIO_ACTIVE_HIGH >, // Spalte 2
                < &gpio0 8 GPIO_ACTIVE_HIGH >, // Spalte 3
                < &gpio0 9 GPIO_ACTIVE_HIGH >, // Spalte 4
                < &gpio0 10 GPIO_ACTIVE_HIGH >; // Spalte 5
    status = "okay";
};
