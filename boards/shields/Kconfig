## boards/shields/cosmotyl/Kconfig
```kconfig
config SHIELD_COSMOTYL_LEFT
    bool "Cosmotyl Left Half"
    select ZMK_SPLIT
    help
        Shield configuration for the left half of my Cosmotyl split keyboard.
```

## boards/shields/cosmotyl/Kconfig.defconfig
```kconfig
# Copyright (c) 2022 The ZMK Contributors
# SPDX-License-Identifier: MIT
#
CONFIG_ZMK_SPLIT_BLE_CENTRAL_BATTERY_LEVEL_PROXY = Y
CONFIG_ZMK_SPLIT_BLE_CENTRAL_BATTERY_LEVEL_FETCHING = Y

if SHIELD_COSMOTYL_LEFT

config ZMK_KEYBOARD_NAME
    default "Cosmotyl DeKo1"
    
config ZMK_SPLIT_ROLE_CENTRAL
    default y

endif

if SHIELD_COSMOTYL_LEFT || SHIELD_COSMOTYL_RIGHT

config ZMK_SPLIT
    default y

endif
```

## boards/shields/cosmotyl/Kconfig.shield
```kconfig
# Copyright (c) 2022 The ZMK Contributors
# SPDX-License-Identifier: MIT

config SHIELD_COSMOTYL_LEFT
    def_bool $(shields_list_contains,cosmotyl_left)

config SHIELD_COSMOTYL_RIGHT
    def_bool $(shields_list_contains,cosmotyl_right)
```
